## board/qca/common/Kconfig
```kconfig
# SPDX-License-Identifier: GPL-2.0
#
# QCA platform common configuration
#

menuconfig QCA_BOOTMENU
	bool "Enable QCA bootmenu framework"
	depends on ARCH_ATH79
	select CMD_BOOTMENU
	select CMD_MTD
	default n
	help
	  Enable QCA bootmenu containing features for easy
	  firmware/bootloader upgrading and booting via a
	  countdown menu at startup.

if QCA_BOOTMENU

config QCA_BOOTMENU_COUNTDOWN
	bool "Enable bootmenu countdown"
	default y
	help
	  Enable bootmenu auto-booting countdown timer.

config QCA_BOOTMENU_DELAY
	int "QCA bootmenu delay time (s)"
	range 1 10
	default 4
	depends on QCA_BOOTMENU_COUNTDOWN
	help
	  The delay seconds for the bootmenu to show before running
	  the default command.

config QCA_BOOTMENU_LEGACY
	bool "Use legacy rootfs+uImage partition layout"
	depends on QCA_BOOTMENU
	default n
	help
	  Use the legacy rootfs+uImage MTD partition scheme instead
	  of the unified firmware partition.

	  Enable this for AP143 and similar devices that have separate
	  rootfs and uImage MTD partitions rather than a single
	  firmware partition.

	  Legacy layout example:
	    u-boot | u-boot-env | rootfs | uImage | ART

	  New layout example:
	    u-boot | u-boot-env | firmware | ART

endif # QCA_BOOTMENU

config QCA_WEB_FAILSAFE
	bool "Enable Web-based failsafe for firmware upgrading"
	default n
	select WEBUI_FAILSAFE
	help
	  Enable Web-based failsafe for firmware upgrading.  A bootmenu
	  item will be added to allow entering failsafe mode.

config QCA_WEB_FAILSAFE_AFTER_BOOT_FAILURE
	bool "Automatically start failsafe after booting failure"
	depends on QCA_WEB_FAILSAFE
	default y
	help
	  If the default OS boot fails, the Web failsafe UI will be
	  started automatically so that a working firmware image can
	  be uploaded without re-entering the bootmenu.

	  When disabled, a boot failure simply returns to the
	  U-Boot console prompt.

config QCA_FAILSAFE_NAND
	bool "Enable NAND flash support for QCA failsafe"
	depends on QCA_WEB_FAILSAFE && MTD && ARCH_ATH79
	default n
	help
	  Enable NAND flash write path for the web failsafe UI.
	  When enabled, the failsafe write functions will perform
	  bad-block-aware erase/write suitable for NAND flash.
	  When disabled (default), only NOR flash is supported.

	  This option is kept for future NAND board support.
	  Current QCA boards (AP143/AP135/AP152) use NOR flash only.

if ARCH_ATH79 && WEBUI_FAILSAFE

config WEBUI_FAILSAFE_VENDOR
	default "Qualcomm Atheros"

endif
```

## board/qca/cus249/Kconfig
```kconfig
if TARGET_CUS249

config SYS_VENDOR
	default "qca"

config SYS_BOARD
	default "cus249"

config SYS_CONFIG_NAME
	default "cus249"

config TEXT_BASE
	default 0x9f000000

endif
```

## configs/qca953x_defconfig
```kconfig
CONFIG_MIPS=y
CONFIG_TEXT_BASE=0x9F000000
CONFIG_SYS_MALLOC_LEN=0x40000
CONFIG_SYS_MALLOC_F_LEN=0x800
CONFIG_HAS_CUSTOM_SYS_INIT_SP_ADDR=y
CONFIG_CUSTOM_SYS_INIT_SP_ADDR=0xbd001fff
CONFIG_ENV_SIZE=0x8000
CONFIG_ENV_OFFSET=0x5a000
CONFIG_ENV_SECT_SIZE=0x10000
CONFIG_DEFAULT_DEVICE_TREE="ap143"
CONFIG_SYS_LOAD_ADDR=0x80060000
CONFIG_DEBUG_UART_BASE=0xb8020000
CONFIG_DEBUG_UART_CLOCK=25000000
CONFIG_DEBUG_UART_BOARD_INIT=y
CONFIG_ARCH_ATH79=y
CONFIG_TARGET_AP143=y
CONFIG_SYS_MIPS_TIMER_FREQ=325000000
CONFIG_DEBUG_UART=y
CONFIG_SYS_MEMTEST_START=0x80100000
CONFIG_SYS_MEMTEST_END=0x80700000
CONFIG_BOOTDELAY=3
CONFIG_USE_BOOTARGS=y
CONFIG_BOOTARGS="console=ttyS0,115200 root=/dev/mtdblock2 rootfstype=squashfs"
CONFIG_USE_BOOTCOMMAND=y
CONFIG_BOOTCOMMAND="sf probe;mtdparts default;bootm 0x9f318000"
CONFIG_SYS_CBSIZE=256
CONFIG_SYS_PBSIZE=281
CONFIG_DISPLAY_CPUINFO=y
CONFIG_BOARD_EARLY_INIT_F=y
CONFIG_SYS_MALLOC_BOOTPARAMS=y
CONFIG_SYS_PROMPT="qca953x # "
# CONFIG_CMD_BDI is not set
# CONFIG_CMD_CONSOLE is not set
# CONFIG_CMD_ELF is not set
# CONFIG_CMD_XIMG is not set
# CONFIG_CMD_EXPORTENV is not set
# CONFIG_CMD_IMPORTENV is not set
# CONFIG_CMD_EDITENV is not set
# CONFIG_CMD_CRC32 is not set
CONFIG_CMD_MEMTEST=y
CONFIG_CMD_SPI=y
CONFIG_CMD_SF=y
CONFIG_CMD_MTDPARTS=y
CONFIG_MTDIDS_DEFAULT="nor0=spi-flash.0"
CONFIG_MTDPARTS_DEFAULT="mtdparts=spi-flash.0:360k(u-boot),32k(u-boot-env),2776k(rootfs),800k(uImage),64k(mib0),64k(ART)"
# CONFIG_ISO_PARTITION is not set
CONFIG_ENV_IS_IN_SPI_FLASH=y
CONFIG_ENV_SPI_MAX_HZ=25000000
CONFIG_ENV_RELOC_GD_ENV_ADDR=y
CONFIG_NET_RANDOM_ETHADDR=y
CONFIG_CMD_DHCP=y
CONFIG_CMD_PING=y
CONFIG_MTD=y
CONFIG_DM_SPI_FLASH=y
CONFIG_SPI_FLASH_BAR=y
CONFIG_SPI_FLASH_ATMEL=y
CONFIG_SPI_FLASH_EON=y
CONFIG_SPI_FLASH_GIGADEVICE=y
CONFIG_SPI_FLASH_ISSI=y
CONFIG_SPI_FLASH_MACRONIX=y
CONFIG_SPI_FLASH_PUYA=y
CONFIG_SPI_FLASH_SILICONKAISER=y
CONFIG_SPI_FLASH_SPANSION=y
CONFIG_SPI_FLASH_STMICRO=y
CONFIG_SPI_FLASH_SST=y
CONFIG_SPI_FLASH_WINBOND=y
CONFIG_SPI_FLASH_XMC=y
CONFIG_SPI_FLASH_XTX=y
CONFIG_SPI_FLASH_ZBIT=y
CONFIG_SPI_FLASH_DATAFLASH=y
CONFIG_SPI_FLASH_MTD=y
CONFIG_USE_IPADDR=y
CONFIG_IPADDR="192.168.1.1"
CONFIG_USE_NETMASK=y
CONFIG_NETMASK="255.255.255.0"
CONFIG_USE_SERVERIP=y
CONFIG_SERVERIP="192.168.1.10"
CONFIG_AG7XXX=y
CONFIG_PHY=y
CONFIG_PHY_ATHEROS=y
CONFIG_PINCTRL=y
CONFIG_DM_SERIAL=y
CONFIG_DEBUG_UART_SHIFT=2
CONFIG_SYS_NS16550=y
CONFIG_SPI=y
CONFIG_DM_SPI=y
CONFIG_ATH79_SPI=y
CONFIG_LZMA=y
```

## failsafe/Kconfig
```kconfig
#
# Failsafe Web UI
#

config WEBUI_FAILSAFE
	bool "Enable Failsafe Web UI"
	select MTK_TCP
	select MTK_HTTPD
	select MTK_DHCPD
	default n
	help
	  Enable Web based failsafe UI.
	  This also starts a minimal DHCP server so that a directly
	  connected PC can obtain an IP automatically.

config WEBUI_FAILSAFE_INITRAMFS
	bool "Enable initramfs boot via Web failsafe"
	depends on WEBUI_FAILSAFE
	default n
	help
	  Allow uploading an initramfs kernel image via the web failsafe
	  UI and booting it directly from RAM without writing to flash.
	  This is useful for recovery, testing, or one-time boot of a
	  custom kernel.

config WEBUI_FAILSAFE_VENDOR
	string "Vendor name for failsafe web UI banner"
	depends on WEBUI_FAILSAFE
	default "MediaTek"
	help
	  Set the vendor name displayed in the failsafe web UI title
	  and banner.  For QCA/Atheros platforms, set this to
	  "Qualcomm Atheros".
```
