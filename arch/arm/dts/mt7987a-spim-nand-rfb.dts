// SPDX-License-Identifier: (GPL-2.0-only OR MIT)

#include "mt7987a.dtsi"
#include "mt7987-pinctrl.dtsi"
#include "mt7987a-rfb-u-boot.dtsi"

/ {
	model = "mt7987";
	compatible = "mediatek,mt7987", "mediatek,mt7987-spim-nand-rfb";

	bl2_verify {
		bl2_compatible = "spim-nand";
	};
};

&spi0 {
	pinctrl-names = "default";
	pinctrl-0 = <&spi0_flash_pins>;
	status = "okay";
};
